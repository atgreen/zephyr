## arch/moxie/Kconfig
```kconfig
# Copyright (c) 2026 Anthony Green
# SPDX-License-Identifier: Apache-2.0

menu "Moxie Options"
	depends on MOXIE

config ARCH
	string
	default "moxie"

config NUM_IRQS
	int
	default 16

config GEN_ISR_TABLES
	default y

config GEN_IRQ_VECTOR_TABLE
	default n

config GEN_SW_ISR_TABLE
	default y
	depends on GEN_ISR_TABLES

endmenu
```

## boards/moxie/mox125_nexys3/Kconfig.defconfig
```kconfig
# Copyright (c) 2026 Anthony Green
# SPDX-License-Identifier: Apache-2.0

if BOARD_MOX125_NEXYS3

config BUILD_OUTPUT_BIN
	default n

endif # BOARD_MOX125_NEXYS3
```

## boards/moxie/mox125_nexys3/board.yml
```yaml
# Copyright (c) 2026 Anthony Green
# SPDX-License-Identifier: Apache-2.0

board:
  name: mox125_nexys3
  full_name: mox125 on the Digilent Nexys 3
  vendor: moxie
  socs:
    - name: mox125
```

## boards/moxie/mox125_nexys3/mox125_nexys3_defconfig
```kconfig
# Copyright (c) 2026 Anthony Green
# SPDX-License-Identifier: Apache-2.0

CONFIG_MOXIE_SIM_TIMER=y
CONFIG_CONSOLE=y
CONFIG_SERIAL=y
CONFIG_UART_CONSOLE=y
CONFIG_STACK_SENTINEL=y
```

## boards/moxie/mox125_sim/Kconfig.mox125_sim
```kconfig
# Copyright (c) 2026 Anthony Green
# SPDX-License-Identifier: Apache-2.0

config BOARD_MOX125_SIM
	select SOC_MOX125
```

## boards/moxie/mox125_sim/board.yml
```yaml
# Copyright (c) 2026 Anthony Green
# SPDX-License-Identifier: Apache-2.0

board:
  name: mox125_sim
  full_name: mox125 Verilator simulation
  vendor: moxie
  socs:
    - name: mox125
```

## drivers/serial/Kconfig.moxie_sim
```kconfig
# Copyright (c) 2026 Anthony Green
# SPDX-License-Identifier: Apache-2.0

config UART_MOXIE_SIM
	bool "mox125 simulation console"
	default y
	depends on DT_HAS_MOXIE_SIM_UART_ENABLED
	select SERIAL_HAS_DRIVER
	help
	  Output-only console provided by the mox125 simulation test bench.
```

## drivers/timer/Kconfig.moxie_sim
```kconfig
# Copyright (c) 2026 Anthony Green
# SPDX-License-Identifier: Apache-2.0

config MOXIE_SIM_TIMER
	bool "mox125 simulation timer"
	default y
	depends on DT_HAS_MOXIE_SIM_TIMER_ENABLED
	help
	  Periodic system timer provided by the mox125 simulation test bench.
```

## dts/bindings/cpu/moxie,mox125.yaml
```yaml
# Copyright (c) 2026 Anthony Green
# SPDX-License-Identifier: Apache-2.0

description: mox125 pipelined Moxie core

compatible: "moxie,mox125"

include: cpu.yaml
```

## dts/bindings/interrupt-controller/moxie,sim-pic.yaml
```yaml
# Copyright (c) 2026 Anthony Green
# SPDX-License-Identifier: Apache-2.0

description: |
  Interrupt controller of the mox125 simulation.  A read of the first
  register gives the pending sources, the second holds the enable mask.

compatible: "moxie,sim-pic"

include: [interrupt-controller.yaml, base.yaml]

properties:
  reg:
    required: true

  "#interrupt-cells":
    const: 1

interrupt-cells:
  - irq
```

## dts/bindings/serial/moxie,sim-uart.yaml
```yaml
# Copyright (c) 2026 Anthony Green
# SPDX-License-Identifier: Apache-2.0

description: Console of the mox125 simulation; bytes written to it are printed.

compatible: "moxie,sim-uart"

include: uart-controller.yaml

properties:
  reg:
    required: true
```

## dts/bindings/timer/moxie,sim-timer.yaml
```yaml
# Copyright (c) 2026 Anthony Green
# SPDX-License-Identifier: Apache-2.0

description: Periodic timer of the mox125 simulation, counting simulated clocks.

compatible: "moxie,sim-timer"

include: base.yaml

properties:
  reg:
    required: true

  interrupts:
    required: true
```

## soc/moxie/mox125/Kconfig
```kconfig
# Copyright (c) 2026 Anthony Green
# SPDX-License-Identifier: Apache-2.0

config SOC_MOX125
	select MOXIE
```

## soc/moxie/mox125/Kconfig.defconfig
```kconfig
# Copyright (c) 2026 Anthony Green
# SPDX-License-Identifier: Apache-2.0

if SOC_MOX125

config SYS_CLOCK_HW_CYCLES_PER_SEC
	default $(dt_node_int_prop_int,/cpus/cpu@0,clock-frequency)

endif # SOC_MOX125
```

## soc/moxie/mox125/Kconfig.soc
```kconfig
# Copyright (c) 2026 Anthony Green
# SPDX-License-Identifier: Apache-2.0

config SOC_MOX125
	bool

config SOC
	default "mox125" if SOC_MOX125
```
